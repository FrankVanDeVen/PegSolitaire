#include <Arduboy2.h>
 Arduboy2 arduboy;
 Sprites sprites;
#define ARDBITMAP_SBUF arduboy.getBuffer()
#include <ArdBitmap.h>
ArdBitmap<WIDTH, HEIGHT> ardbitmap;

const unsigned char PROGMEM peg[] = { 8, 8,
0x00,0x18,0x24,0x42,0x42,0x24,0x18,0x00, // circle open
0x00,0x18,0x3C,0x7E,0x7E,0x3C,0x18,0x00, // circle colored
0x00,0x00,0x00,0x00,0x00,0x00,0x00,0x00, // empty space (for flashing function)
0xFF,0x99,0xA5,0xC3,0xC3,0xA5,0x99,0xFF, // circle open + square
0xFF,0x99,0xBD,0xFF,0xFF,0xBD,0x99,0xFF, // circle colored + square
0xFF,0x81,0x81,0x81,0x81,0x81,0x81,0xFF, // empty space + square (for flashing function) 
};

const unsigned char PROGMEM plaatje[] = { // intro image with text buttons A and B
 0x7f, 0xff, 0x7f, 0x58, 0xa3, 0x80, 0x0a, 0x68, 0x3c, 0x18, 0x41, 0xa0, 0x80, 0x60, 0x3c,
 0x18, 0x05, 0x54, 0x40, 0xe3, 0x7f, 0x43, 0x0d, 0x20, 0x45, 0x20, 0x5e, 0x1d, 0x08, 0x82,
 0x0c, 0xaf, 0x06, 0x10, 0x04, 0x81, 0x78, 0x35, 0x80, 0x20, 0x08, 0xc4, 0xab, 0x01, 0x04,
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 0x53, 0x00,};

// variables
 byte bord[9][9] = {{2,2,2,2,2,2,2,2,2},{2,2,2,1,1,1,2,2,2},{2,2,2,1,1,1,2,2,2},
 {2,1,1,1,1,1,1,1,2},{2,1,1,1,0,1,1,1,2},{2,1,1,1,1,1,1,1,2},{2,2,2,1,1,1,2,2,2},
 {2,2,2,1,1,1,2,2,2},{2,2,2,2,2,2,2,2,2}}; // board: 0= open place 1= peg 2= no playing field

 byte x1 = 4;                         // x cursor position
 byte y1 = 4;                         // y cursor position
 byte x2;                             // x position selected peg
 byte y2;                             // y position selected peg
 byte z;                              // at 3: draw cursor square 
 bool knipper = 0;                    // at 1: makes peg flash
 unsigned long tijd;                  // flashing time
 byte tel = 31;                       // counts the number of pegs played away
 byte mem[32][3];                     // contains the 30 moves made previously

void setup() {
 arduboy.begin();                     // initialized the Arduboy2 library
 tijd = millis();                     // save the time
 intro();                             // draw intro image + read buttons A and B
}

void loop() {
 arduboy.setFrameRate(60);
 if (!(arduboy.nextFrame())) {return;}
 arduboy.pollButtons();               // only check 1x in loop if button is pressed
 arduboy.clear();                     // clear display buffer
 lees_richtingknoppen();              // read direction buttons + adjust x and y position
 lees_A_button();                     // button A selects peg or move pegs (make a jump)
 lees_B_button();                     // button B get old cursorpos.+ location pegs from stack
 print_spelbord();                    // put game board on screen
 print_aantal_pegs();                 // print number of pegs + control game has ended
 arduboy.display();                   // put the contents of video memory on the display
}
//-------------------------------------------------------------------------------------------

// draw intro image on screen and read buttons. A (print info text) and B (play game)
void intro() {
 arduboy.clear();
 ardbitmap.drawCompressed(WIDTH/2 ,HEIGHT/2, plaatje, WHITE, ALIGN_CENTER, MIRROR_NONE);
 arduboy.display();
 while (arduboy.pressed(A_BUTTON) == 0 && arduboy.pressed(B_BUTTON) == 0) {}
 if (arduboy.pressed(A_BUTTON) == 1) {print_info();}
}

// print info text
void print_info() { 
 arduboy.clear();
 arduboy.setTextSize(1);
  arduboy.setCursor(0,0);  arduboy.print(F("The goal is to clear"));
  arduboy.setCursor(0,8);  arduboy.print(F("the pegs until the"));
  arduboy.setCursor(0,17); arduboy.print(F("middle one remains."));
  arduboy.setCursor(0,26); arduboy.print(F("Jump horizontally or"));
  arduboy.setCursor(0,35); arduboy.print(F("vertically over 1 peg"));
  arduboy.setCursor(0,44); arduboy.print(F("A:select,jump. B:back"));
  arduboy.setCursor(0,53); arduboy.print(F("Code:Frank van de Ven"));
 arduboy.display();
 while (arduboy.pressed(A_BUTTON) == 1) {}
 while (arduboy.pressed(A_BUTTON) == 0 && arduboy.pressed(B_BUTTON) == 0) {}
}

// read direction buttons and adjust the x and y position
void lees_richtingknoppen() {
 if (arduboy.justPressed(UP_BUTTON)) {if (bord[x1][y1-1]!= 2) {y1 = y1 - 1;}}
 if (arduboy.justPressed(DOWN_BUTTON)) {if (bord[x1][y1+1]!= 2) {y1 = y1 + 1;}}
 if (arduboy.justPressed(LEFT_BUTTON)) {if (bord[x1-1][y1]!= 2) {x1 = x1 - 1;}}
 if (arduboy.justPressed(RIGHT_BUTTON)) {if (bord[x1+1][y1]!= 2) {x1 = x1 + 1;}} 
}

// read A butten and select or move the peg. After a move turn off the selection (x2,y2=0)
void  lees_A_button() {
 if (arduboy.justPressed(A_BUTTON)) {
  if (bord[x1][y1]==1) {x2=x1;y2=y1;}
   else {
    if (bord[x1+1][y1]==1 && x1+2==x2 && y1==y2)
     {mem[tel][0]=x1+y1*8; mem[tel][1]=(x1+1)+y1*8; mem[tel][2]=(x1+2)+y1*8;
      bord[x1][y1]=1; bord[x1+1][y1]=0; bord[x1+2][y1]=0; x2=0; y2=0; tel--;}
    if (bord[x1-1][y1]==1 && x1-2==x2 && y1==y2)
     {mem[tel][0]=x1+y1*8; mem[tel][1]=(x1-1)+y1*8; mem[tel][2]=(x1-2)+y1*8;
      bord[x1][y1]=1; bord[x1-1][y1]=0; bord[x1-2][y1]=0; x2=0; y2=0; tel--;}
    if (bord[x1][y1+1]==1 && y1+2==y2 && x1==x2)
     {mem[tel][0]=x1+y1*8; mem[tel][1]=x1+(y1+1)*8; mem[tel][2]=x1+(y1+2)*8;
      bord[x1][y1]=1; bord[x1][y1+1]=0; bord[x1][y1+2]=0; x2=0; y2=0; tel--;}
    if (bord[x1][y1-1]==1 && y1-2==y2 && x1==x2)
     {mem[tel][0]=x1+y1*8; mem[tel][1]=x1+(y1-1)*8; mem[tel][2]=x1+(y1-2)*8;
      bord[x1][y1]=1; bord[x1][y1-1]=0; bord[x1][y1-2]=0; x2=0; y2=0; tel--;}
   }
  }
}

// read B button and get old cursor position + stand pegs from stack
void lees_B_button() {
 if (arduboy.justPressed(B_BUTTON)) { 
  if (tel < 31){
   for (byte nr=0; nr < 3; nr++) {
    x1=mem[tel+1][nr] & 0x07; y1 = mem[tel+1][nr] >> 3;
    bord[x1][y1] = !!nr;
   }
   x2=0; y2=0; tel++;
  }
 }
}

// print number of pegs + control end game
void print_aantal_pegs() {
 if (tel != 0) {
  arduboy.setTextSize(2);
  arduboy.setCursor(85, 5);
  arduboy.print(tel);
  arduboy.setTextSize(1);
  arduboy.setCursor(65, 26);
  arduboy.print(F("pegs to go"));
 }
 else {
  arduboy.setTextSize(1);
   if (bord[4][4]==1) {
   arduboy.setCursor(45, 8);
   arduboy.print(F("Congratulation"));
   arduboy.display();
   while(1);
   }
   else {  
   arduboy.setCursor(65, 8);
   arduboy.print(F("Wrong spot"));
   }
 }
}

// put game board on screen
void print_spelbord() {
 if (tijd+500 < millis()) {tijd = millis();knipper ^=1;}
 for (byte x=1;x<8;x++){
  for (byte y=1;y<8;y++){
   if (bord[x][y] < 2) {
   if (x==x1 && y==y1){z=3;} else {z=0;}
   if (x==x2 && y==y2 && knipper==1) {
    sprites.drawOverwrite(x*8-5, y*8-5, peg, 2+z);
    }
    else
    { sprites.drawOverwrite(x*8-5, y*8-5, peg, bord[x][y]+z);
    }
   }
  }
 }
}
